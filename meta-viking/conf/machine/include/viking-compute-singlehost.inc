## meta-viking/conf/machine/include/viking-compute-singlehost.inc
```bitbake
MACHINEOVERRIDES =. "vk-compute-singlehost:"

require conf/machine/include/viking-compute.inc
```

## meta-viking/conf/machine/include/viking-compute.inc
```bitbake
MACHINEOVERRIDES =. "vk-compute:"

require conf/machine/include/viking-withhost.inc
```

## meta-viking/conf/machine/include/viking.inc
```bitbake
DISTROOVERRIDES .= ":viking"

MACHINE_FEATURES += "\
        obmc-bmc-state-mgmt \
        obmc-phosphor-fan-mgmt \
        obmc-phosphor-flash-mgmt \
        "

VIRTUAL-RUNTIME_skeleton_workbook = "${MACHINE}-config"

PREFERRED_PROVIDER_virtual/obmc-chassis-mgmt = "packagegroup-vk-apps"
PREFERRED_PROVIDER_virtual/obmc-fan-mgmt = "packagegroup-vk-apps"
PREFERRED_PROVIDER_virtual/obmc-flash-mgmt = "packagegroup-vk-apps"
PREFERRED_PROVIDER_virtual/obmc-inventory-data ?= "${VIRTUAL-RUNTIME_skeleton_workbook}"
PREFERRED_PROVIDER_virtual/obmc-system-mgmt = "packagegroup-vk-apps"

IMAGE_FEATURES:remove = "obmc-ikvm"
IMAGE_FEATURES:append = " allow-root-login"

# Most of our hardware uses the default ttyS4 but at 57600.
SERIAL_CONSOLES:viking = "57600;ttyS4"
```

## meta-viking/meta-wetterhorn/conf/layer.conf
```bitbake
# We have a conf and classes directory, add to BBPATH
BBPATH .= ":${LAYERDIR}"

# We have recipes-* directories, add to BBFILES
BBFILES += "${LAYERDIR}/recipes-*/*/*.bb \
            ${LAYERDIR}/recipes-*/*/*.bbappend"

BBFILE_COLLECTIONS += "wetterhorn-layer"
BBFILE_PATTERN_wetterhorn-layer := "^${LAYERDIR}/"

LAYERSERIES_COMPAT_wetterhorn-layer := "honister kirkstone"
```
